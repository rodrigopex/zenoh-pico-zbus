## CMakeLists.txt
```
cmake_minimum_required(VERSION 3.22.1)

if (BOARD MATCHES "rpi_pico")
    add_definitions(-DZENOH_NO_STDATOMIC)
endif ()

find_package(Zephyr REQUIRED HINTS $ENV{ZEPHYR_BASE})
project(zenoh_pico_zbus)

set(ZENOHPICO_INCLUDE_DIR ${CMAKE_SOURCE_DIR}/zenoh-pico/include)

file(GLOB Sources
        "zenoh-pico/src/*.c"
        "zenoh-pico/src/api/*.c"
        "zenoh-pico/src/net/*.c"
        "zenoh-pico/src/collections/*.c"
        "zenoh-pico/src/link/*.c"
        "zenoh-pico/src/link/config/*.c"
        "zenoh-pico/src/link/unicast/*.c"
        #        "zenoh-pico/src/link/multicast/*.c"
        "zenoh-pico/src/protocol/*.c"
        "zenoh-pico/src/protocol/keyexpr/*.c"
        "zenoh-pico/src/session/*.c"
        "zenoh-pico/src/system/zephyr/*.c"
        "zenoh-pico/src/transport/*.c"
        "zenoh-pico/src/transport/common/*.c"
        "zenoh-pico/src/transport/unicast/*.c"
        "zenoh-pico/src/transport/unicast/link/*.c"
        "zenoh-pico/src/transport/unicast/link/task/*.c"
        #        "zenoh-pico/src/transport/multicast/*.c"
        #        "zenoh-pico/src/transport/multicast/link/*.c"
        #        "zenoh-pico/src/transport/multicast/link/task/*.c"
        "zenoh-pico/src/utils/*.c"
        )

add_definitions(-DZENOH_ZEPHYR)

include_directories(app PUBLIC ${ZENOHPICO_INCLUDE_DIR})
#target_link_libraries(app PUBLIC zenohpico_lib)

target_sources(app
        PRIVATE
        ${Sources}
        src/main.c
        )
```

## prj.conf
```kconfig
# Kernel options
CONFIG_MAIN_STACK_SIZE=5120
CONFIG_HEAP_MEM_POOL_SIZE=4096
CONFIG_ENTROPY_GENERATOR=y
CONFIG_TEST_RANDOM_GENERATOR=y
CONFIG_INIT_STACKS=y

# Generic library options
CONFIG_NEWLIB_LIBC=y
# CONFIG_NEWLIB_LIBC_NANO=y
CONFIG_POSIX_API=y

# Generic networking options
CONFIG_SERIAL=y

# Logging
CONFIG_NET_LOG=y
CONFIG_LOG=y
CONFIG_NET_STATISTICS=y
CONFIG_PRINTK=y
```

## src/main.c
```c
//
// Copyright (c) 2022 ZettaScale Technology
//
// This program and the accompanying materials are made available under the
// terms of the Eclipse Public License 2.0 which is available at
// http://www.eclipse.org/legal/epl-2.0, or the Apache License, Version 2.0
// which is available at https://www.apache.org/licenses/LICENSE-2.0.
//
// SPDX-License-Identifier: EPL-2.0 OR Apache-2.0
//
// Contributors:
//   ZettaScale Zenoh Team, <zenoh@zettascale.tech>

#include <stdio.h>
#include <stdlib.h>
#include <string.h>
#include <unistd.h>
#include <zenoh-pico.h>

#define CLIENT_OR_PEER 0  // 0: Client mode; 1: Peer mode
#if CLIENT_OR_PEER == 0
#define MODE "client"
#define PEER "serial/uart0#baudrate=115200"  // If empty, it will scout
//#elif CLIENT_OR_PEER == 1
//#define MODE "peer"
//#define PEER "udp/224.0.0.225:7447#iface=en0"
#else
#error "Unknown Zenoh operation mode. Check CLIENT_OR_PEER value."
#endif

#define KEYEXPR "demo/example/zenoh-pico-pub"
#define VALUE "[STSTM32]{nucleo-F767ZI} Pub from Zenoh-Pico!"

int main(int argc, char **argv) {
    sleep(5);

    // Initialize Zenoh Session and other parameters
    z_owned_config_t config = z_config_default();
    zp_config_insert(z_loan(config), Z_CONFIG_MODE_KEY, z_string_make(MODE));
    if (strcmp(PEER, "") != 0) {
        zp_config_insert(z_loan(config), Z_CONFIG_PEER_KEY, z_string_make(PEER));
    }

    // Open Zenoh session
    printf("Opening Zenoh Session...");
    z_owned_session_t s = z_open(z_move(config));
    if (!z_check(s)) {
        printf("Unable to open session!\n");
        exit(-1);
    }
    printf("OK\n");

    // Start the receive and the session lease loop for zenoh-pico
    zp_start_read_task(z_loan(s), NULL);
    zp_start_lease_task(z_loan(s), NULL);

    printf("Declaring publisher for '%s'...", KEYEXPR);
    z_owned_publisher_t pub = z_declare_publisher(z_loan(s), z_keyexpr(KEYEXPR), NULL);
    if (!z_check(pub)) {
        printf("Unable to declare publisher for key expression!\n");
        exit(-1);
    }
    printf("OK\n");

    char buf[256];
    for (int idx = 0; 1; ++idx) {
        sleep(1);
        sprintf(buf, "[%4d] %s", idx, VALUE);
        printf("Putting Data ('%s': '%s')...\n", KEYEXPR, buf);
        z_publisher_put(z_loan(pub), (const uint8_t *)buf, strlen(buf), NULL);
    }

    printf("Closing Zenoh Session...");
    z_undeclare_publisher(z_move(pub));

    // Stop the receive and the session lease loop for zenoh-pico
    zp_stop_read_task(z_loan(s));
    zp_stop_lease_task(z_loan(s));

    z_close(z_move(s));
    printf("OK!\n");

    return 0;
}
```
